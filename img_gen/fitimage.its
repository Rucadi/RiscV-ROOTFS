## img_gen/fitimage.its
```
/dts-v1/;

/ {
        description = "U-boot FIT image RISCV";
        #address-cells = <2>;

        images {

                kernel {
                        description = "Linux kernel";
                        data = /incbin/("kernel_img/Image.gz");
                        type = "kernel";
                        arch = "riscv";
                        os = "linux";
                        load = <0x80200000>;
                        entry = <0x80200000>;
                        compression = "gzip";
                        hash-1 {
                                algo = "sha256";
                        };
                };


                fdt {
                        description = "FDT";
                        data = /incbin/("device-tree/riscv.dtb");
                        type = "flat_dt";
                        arch = "riscv";
                        load = <0x81f00000>;
                        compression = "none";
                        hash-1 {
                                algo = "sha256";
                        };
                };

                ramdisk {
                        description = "initramfs";
                        data = /incbin/("rootfs/rootfs.cpio.gz");
                        type = "ramdisk";
                        arch = "riscv";
                        os = "linux";
                        load = <0x82000000>;
                        compression = "gzip";
                };


        };

        configurations {
                default = "config-1";

                config-1 {
                        description = "RiscV";
                        kernel = "kernel";
                        fdt = "fdt";
                        ramdisk = "ramdisk";
                };
        };
};
```
